#include <Wire.h>
#include <Adafruit_GFX.h>
#include <Adafruit_SSD1306.h>
#include <esp_random.h>

#include <DEBUG.h>
#include <globals.h>
#include <display.h>

constexpr uint8_t DISPLAY_WIDTH = 128;
constexpr uint8_t DISPLAY_HEIGHT = 32;

constexpr uint8_t DATALIM = 100;
constexpr uint8_t FONT_WIDTH = 3;
constexpr uint8_t FONT_HEIGHT = 4;

constexpr uint8_t CAR_POS_X = 28 + 5;
constexpr uint8_t CAR_POS_Y = 8;

constexpr uint8_t FRAMERATE = 60;
constexpr uint8_t SPRITE_FRAMERATE = 12;

TwoWire oledI2C = TwoWire(1);
Adafruit_SSD1306 display(128, 32, &oledI2C, -1);

// 'idle', 76x24px (2x)
const uint8_t miata_idle_0_px[] PROGMEM = {
    0x00, 0x00, 0x00, 0xff, 0xff, 0x00, 0x00, 0x00, 0x00, 0x00, 0x00, 0x00, 0x00, 0xff, 0xff, 0x00,
    0x00, 0x00, 0x00, 0x00, 0x00, 0x00, 0x0f, 0xc0, 0x00, 0xf0, 0x00, 0x00, 0x00, 0x00, 0x00, 0x00,
    0x0f, 0xc0, 0x00, 0xf0, 0x00, 0x00, 0x00, 0x00, 0x3c, 0x00, 0x3f, 0xc0, 0x00, 0x0c, 0x00, 0x00,
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    0x00, 0x00, 0x00, 0xff, 0x00, 0x00, 0x00, 0x3f, 0xc0, 0x00, 0x00, 0x00, 0x00, 0xff, 0x00, 0x00};
const uint8_t miata_idle_1_px[] PROGMEM = {
    0x00, 0x00, 0x00, 0x00, 0x00, 0x00, 0x00, 0x00, 0x00, 0x00, 0x00, 0x00, 0x00, 0x00, 0x00, 0x00,
    0x00, 0x00, 0x00, 0x00, 0x00, 0x00, 0x00, 0xff, 0xff, 0x00, 0x00, 0x00, 0x00, 0x00, 0x00, 0x00,
    0x00, 0xff, 0xff, 0x00, 0x00, 0x00, 0x00, 0x00, 0x00, 0x00, 0x0f, 0xc0, 0x00, 0xf0, 0x00, 0x00,
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    0xff, 0xff, 0xfc, 0xff, 0x0f, 0xc0, 0x3f, 0x3f, 0xc3, 0xff, 0xff, 0xff, 0xfc, 0xff, 0x0f, 0xc0};

// 'exhaust', 16x7px
const uint8_t miata_exhaust0[] PROGMEM = {
    0x00, 0x00, 0x00, 0x00, 0x0e, 0x00, 0x1f, 0x3e, 0x1f, 0xf0, 0x1d, 0xe0, 0x00, 0x00};
const uint8_t miata_exhaust1[] PROGMEM = {
    0x00, 0x00, 0x00, 0x00, 0x38, 0x00, 0x7f, 0x00, 0x3f, 0xf0, 0x03, 0x00, 0x00, 0x00};
const uint8_t miata_exhaust2[] PROGMEM = {
    0x00, 0x00, 0x00, 0x00, 0x38, 0x00, 0x7c, 0x00, 0x3c, 0x00, 0x1f, 0x00, 0x00, 0x00};
const uint8_t miata_exhaust3[] PROGMEM = {
    0x00, 0x00, 0x60, 0x00, 0xf0, 0x00, 0xf8, 0x00, 0x78, 0x00, 0x38, 0x00, 0x00, 0x00};
const uint8_t miata_exhaust4[] PROGMEM = {
    0x60, 0x00, 0xe0, 0x00, 0xe0, 0x00, 0xe0, 0x00, 0x00, 0x00, 0x00, 0x00, 0x00, 0x00};

// 'bt_icons', 14x14px (2x)
const uint8_t miata_bt_conn[] PROGMEM = {
    0x03, 0x00, 0x03, 0x00, 0x33, 0xc0, 0x33, 0xc0, 0x0f, 0x30, 0x0f, 0x30, 0x03, 0xc0, 0x03, 0xc0,
    0x0f, 0x30, 0x0f, 0x30, 0x33, 0xc0, 0x33, 0xc0, 0x03, 0x00, 0x03, 0x00};
const uint8_t miata_bt_disconn[] PROGMEM = {
    0xc3, 0x00, 0xc3, 0x00, 0x30, 0xc0, 0x30, 0xc0, 0x0c, 0x30, 0x0c, 0x30, 0x03, 0x00, 0x03, 0x00,
    0x0f, 0xc0, 0x0f, 0xc0, 0x33, 0x30, 0x33, 0x30, 0x03, 0x0c, 0x03, 0x0c};

// 'mute_small', 14x14px (2x)
const uint8_t miata_mute_small[] PROGMEM = {
    0xc3, 0xc0, 0xc3, 0xc0, 0x30, 0xc0, 0x30, 0xc0, 0x3c, 0x00, 0x3c, 0x00, 0xff, 0x00, 0xff, 0x00,
    0x3f, 0xc0, 0x3f, 0xc0, 0x0f, 0xf0, 0x0f, 0xf0, 0x03, 0xcc, 0x03, 0xcc};

// 'mute', 26x26px (2x)
const uint8_t miata_mute[] PROGMEM = {
    0xc0, 0x00, 0x00, 0x00, 0xc0, 0x00, 0x00, 0x00, 0x30, 0x00, 0xc0, 0x00, 0x30, 0x00, 0xc0, 0x00,
    0x0c, 0x03, 0xc0, 0x00, 0x0c, 0x03, 0xc0, 0x00, 0x03, 0x0f, 0xc0, 0x00, 0x03, 0x0f, 0xc0, 0x00,
    0x03, 0xc3, 0xc0, 0x00, 0x03, 0xc3, 0xc0, 0x00, 0x0f, 0xf0, 0xc0, 0x00, 0x0f, 0xf0, 0xc0, 0x00,
    0x0f, 0xfc, 0x00, 0x00, 0x0f, 0xfc, 0x00, 0x00, 0x0f, 0xff, 0x00, 0x00, 0x0f, 0xff, 0x00, 0x00,
    0x03, 0xff, 0xc0, 0x00, 0x03, 0xff, 0xc0, 0x00, 0x00, 0x0f, 0xf0, 0x00, 0x00, 0x0f, 0xf0, 0x00,
    0x00, 0x03, 0xcc, 0x00, 0x00, 0x03, 0xcc, 0x00, 0x00, 0x00, 0xc3, 0x00, 0x00, 0x00, 0xc3, 0x00,
    0x00, 0x00, 0x00, 0xc0, 0x00, 0x00, 0x00, 0xc0};

const uint8_t *miata_idle_animation[] = {
    miata_idle_0_px,
    miata_idle_1_px,
};

const uint8_t *miata_exhaust_animation[] = {
    miata_exhaust0,
    miata_exhaust1,
    miata_exhaust2,
    miata_exhaust3,
    miata_exhaust4,
};

constexpr uint8_t IDLE_ANIMATION_FRAME_COUNT = sizeof(miata_idle_animation) / sizeof(miata_idle_animation[0]);
constexpr uint8_t EXHAUST_ANIMATION_FRAME_COUNT = sizeof(miata_exhaust_animation) / sizeof(miata_exhaust_animation[0]);

enum display_owner_t
{
    OWNER_NONE,
    OWNER_ANIMATION,
    OWNER_PLAYING
};
display_owner_t display_owner = OWNER_NONE;

void render_centered_text_2x(const char *text)
{
    display.clearDisplay();
    display.setTextColor(SSD1306_WHITE);
    display.setTextSize(2);
    display.setCursor(64 - (FONT_WIDTH * 2) * strlen(text), 16 - (FONT_HEIGHT * 2) / 2);
    display.println(text);
    display.display();
}

void render_play_state()
{
    display.clearDisplay();
    if (media_enabled.get()) // Song title, artist, album display
    {
        global_marquee_clock++;
        meta.title_marquee.marquee_step();
        meta.artist_marquee.marquee_step();
        meta.album_marquee.marquee_step();

        display.setTextColor(SSD1306_WHITE);
        display.setTextSize(2);
        display.setCursor(0, 0);
        display.println(meta.title_marquee.rendered_text);
        display.setTextSize(1);
        display.println(meta.album_marquee.rendered_text);
        display.println(meta.artist_marquee.rendered_text);
        if (meta.playtime_ms > 0)
        {
            uint32_t elapsed = millis() - meta.play_start;
            uint32_t progress = (elapsed * DISPLAY_WIDTH) / meta.playtime_ms;
            display.fillRect(0, 31, progress, 2, SSD1306_WHITE);
        }
    }
    else // Mute icon
    {
        display.drawBitmap(DISPLAY_WIDTH / 2 - 26 / 2, DISPLAY_HEIGHT / 2 - 26 / 2, miata_mute, 26, 26, SSD1306_WHITE);
    }
    display.display();
}

void task_playing(void *_)
{
    for (;;)
    {
        if (display_owner != OWNER_PLAYING) // no longer owning the display, terminate
        {
            DEBUG_PRINTLN("Playing task terminating");
            vTaskDelete(NULL);
        }
        render_play_state();
        vTaskDelay(500 / portTICK_PERIOD_MS);
    }
}

constexpr uint8_t NUM_LINES = 5;
constexpr uint8_t LINE_SPEED = 10;
uint8_t line_y[NUM_LINES] = {0};
uint8_t line_w[NUM_LINES] = {0};
int line_x[NUM_LINES] = {0};

constexpr uint8_t MASK_OFFSET_X = 5 * 2;
constexpr uint8_t MASK_OFFSET_Y = 7 * 2;

constexpr int16_t EXHAUST_OFFSET_X = 11 - 30;
constexpr int16_t EXHAUST_OFFSET_Y = 23 - 9;

bool splash_shown = false; // splash will only ever be shown once on startup
animation_state_t animation_state = ANIMATION_BT_DISCONNECTED;
void task_idle_animation(void *_)
{
    if (!splash_shown)
    {
        render_centered_text_2x("miatamoto");
        splash_shown = true;
        vTaskDelay(1000 / portTICK_PERIOD_MS);
    }
    constexpr uint8_t FRAME_DIVIDER = FRAMERATE / SPRITE_FRAMERATE;
    for (uint8_t frame = 0;; frame++)
    {
        if (display_owner != OWNER_ANIMATION) // no longer owning the display, terminate
        {
            DEBUG_PRINTLN("Animation task terminating");
            vTaskDelete(NULL);
        }
        display.clearDisplay();
        for (int i = 0; i < NUM_LINES; i++)
        {
            line_x[i] -= LINE_SPEED;
            if (line_x[i] + line_w[i] < 0) // line is off screen, replace with another
            {
                line_x[i] = DISPLAY_WIDTH; // spawn on far right
                line_y[i] = esp_random() % DISPLAY_HEIGHT - 6;
                line_w[i] = 16 + (esp_random() % 64);
            }
            display.drawFastHLine(line_x[i], line_y[i], line_w[i], SSD1306_WHITE);
        }
        uint8_t sprite_frame = frame / FRAME_DIVIDER;
        display.fillRect(CAR_POS_X + MASK_OFFSET_X, CAR_POS_Y + EXHAUST_OFFSET_Y, 27 * 2, 4 * 2, SSD1306_BLACK); // make wheels and body opaque
        display.drawBitmap(CAR_POS_X, CAR_POS_Y, miata_idle_animation[sprite_frame % IDLE_ANIMATION_FRAME_COUNT], 76, 24, SSD1306_WHITE);
        uint exhaust_frame = sprite_frame % (EXHAUST_ANIMATION_FRAME_COUNT + 5); // 5 frames of no exhaust
        if (exhaust_frame < EXHAUST_ANIMATION_FRAME_COUNT)
        {
            display.drawBitmap(CAR_POS_X + EXHAUST_OFFSET_X, CAR_POS_Y + EXHAUST_OFFSET_Y, miata_exhaust_animation[exhaust_frame], 16, 7, SSD1306_WHITE);
        }
        if (animation_state == ANIMATION_BT_CONNECTING_DISCONNECTING && sprite_frame % 2 == 0) // flickering connection animation
        {
            display.drawBitmap(0, 0, miata_bt_conn, 14, 14, SSD1306_WHITE);
        }
        else if (animation_state == ANIMATION_BT_CONNECTED)
        {
            display.drawBitmap(0, 0, miata_bt_conn, 14, 14, SSD1306_WHITE);
        }
        else if (animation_state == ANIMATION_BT_DISCONNECTED)
        {
            display.drawBitmap(0, 0, miata_bt_disconn, 14, 14, SSD1306_WHITE);
        }
        if (!media_enabled.get())
        {
            display.drawBitmap(0, DISPLAY_HEIGHT - 14, miata_mute_small, 14, 14, SSD1306_WHITE);
        }
        display.display();
        vTaskDelay((1000 / FRAMERATE) / portTICK_PERIOD_MS);
    }
}

display_state_t current_state = DISPLAY_NONE;
void display_setstate(display_state_t state)
{
    DEBUG_PRINTF("Display state: %d, prev state: %d\n", state, current_state);
    if (state == current_state) // no change in state
        return;
    current_state = state;
    switch (state)
    {
    case DISPLAY_ANIMATION:
        display_owner = OWNER_ANIMATION;
        xTaskCreate(task_idle_animation, "task_idle_animation", 2048, NULL, 1, NULL);
        break;
    case DISPLAY_PLAYING:
        display_owner = OWNER_PLAYING;
        xTaskCreate(task_playing, "task_playing", 2048, NULL, 1, NULL);
        break;
    case DISPLAY_NONE:
        display_owner = OWNER_NONE;
        render_centered_text_2x("ERROR"); // we should never get to this state. If only this was rust, we would know.
        break;
    }
}

void display_animation_setstate(animation_state_t state)
{
    DEBUG_PRINTF("Animation state: %d\n", state);
    animation_state = state;
}

void on_media_enabled_changed(bool enabled)
{
    DEBUG_PRINTF("media_enabled set to : %d\n", enabled);
    if (current_state == DISPLAY_PLAYING) // Need a special case for playing state as its framerate is not fast enough to have a responsive feedback
    {
        render_play_state();
    }
}

void setup_display()
{

    oledI2C.begin(DISPLAY_SDA, DISPLAY_SCL);
    if (display.begin(SSD1306_SWITCHCAPVCC, 0x3C))
    {
        display.setTextWrap(false);
        display_setstate(DISPLAY_ANIMATION);
    }
    else
    {
        DEBUG_PRINTLN(F("SSD1306 allocation failed"));
    }
    media_enabled.addListener(on_media_enabled_changed);
}